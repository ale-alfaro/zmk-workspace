## west.yml
```
manifest:
  remotes:
    - name: zephyrproject-rtos
      url-base: https://github.com/zephyrproject-rtos
    - name: zmkfirmware
      url-base: https://github.com/zmkfirmware
    - name: petejohanson
      url-base: https://github.com/petejohanson
  projects:
    - name: zephyr
      remote: petejohanson
      revision: v4.1.0+zmk-fixes
      import: true
    - name: lvgl
      revision: f1db87ee98f1810328a8419572fa42a3b5f352ae
      path: modules/lib/gui/lvgl
      remote: zmkfirmware
    - name: zmk-studio-messages
      revision: 6cb4c283e76209d59c45fbcb218800cd19e9339d
      path: modules/msgs/zmk-studio-messages
      remote: zmkfirmware
  group-filter: [+optional, +debug, -tee, +crypto, +bootloader]
  self:
    west-commands: scripts/west-commands.yml
```

## prj.conf
```kconfig
CONFIG_APPLICATION_DEFINED_SYSCALL=y
CONFIG_DEBUG_OPTIMIZATIONS=y
CONFIG_LOG=y
CONFIG_KSCAN_LOG_LEVEL_DBG=y
CONFIG_THREAD_NAME=y
CONFIG_SCHED_CPU_MASK=y
CONFIG_THREAD_ANALYZER=y
CONFIG_LOG_PROCESS_THREAD_STARTUP_DELAY_MS=8000
```

## boards/rpi_pico.conf
```kconfig
# CONFIG_CONSOLE=n
# CONFIG_SERIAL=n
# CONFIG_UART_CONSOLE=n
# CONFIG_UART_INTERRUPT_DRIVEN=n
# CONFIG_ZMK_USB=y
#
# CONFIG_MPU_ALLOW_FLASH_WRITE=y
# CONFIG_NVS=y
# CONFIG_SETTINGS_NVS=y
# CONFIG_FLASH=y
# CONFIG_FLASH_PAGE_LAYOUT=y
# CONFIG_FLASH_MAP=y
```

## src/main.c
```c
/*
 * Copyright (c) 2020 The ZMK Contributors
 *
 * SPDX-License-Identifier: MIT
 */

#include <zephyr/kernel.h>
#include <zephyr/device.h>
#include <zephyr/devicetree.h>
#include <zephyr/settings/settings.h>

#include <zephyr/logging/log.h>
LOG_MODULE_REGISTER(zmk, CONFIG_ZMK_LOG_LEVEL);

#if IS_ENABLED(CONFIG_ZMK_DISPLAY)

#include <zmk/display.h>
#include <lvgl.h>

#endif

int main(void) {

    LOG_INF("Starting ZMK");
#if IS_ENABLED(CONFIG_SETTINGS)
    settings_subsys_init();
    settings_load();
#endif

#ifdef CONFIG_ZMK_DISPLAY
    zmk_display_init();

#if IS_ENABLED(CONFIG_ARCH_POSIX)
    // Workaround for an SDL display issue:
    // https://github.com/zephyrproject-rtos/zephyr/issues/71410
    while (1) {
        lv_task_handler();
        k_sleep(K_MSEC(10));
    }
#endif

#endif /* CONFIG_ZMK_DISPLAY */

    return 0;
}
```
