## boards/shields/tester_corne_rpico/Kconfig.defconfig
```kconfig
if SHIELD_TESTER_CORNE_RPICO

config ZMK_KEYBOARD_NAME
    default "Tester Corne RPICO"

config ZMK_BLE
    def_bool n

config SETTINGS
    def_bool n


endif
```

## zmk/app/boards/sparkfun/pro_micro_rpico/Kconfig
```kconfig
# Copyright (c) 2021 Yonatan Schachter
# SPDX-License-Identifier: Apache-2.0

# config BOARD_RPI_PICO
# 	select RP2_FLASH_W25Q080
config BOARD_SPARKFUN_PRO_MICRO_RPICO
	select SOC_RP2040
	select RP2_FLASH_W25Q080
```

## zmk/app/boards/sparkfun/pro_micro_rpico/board.yml
```yaml
board:
  name: sparkfun_pro_micro_rpico
  full_name: SparkFun Pro Micro RPICO
  vendor: sparkfun
  socs:
  - name: rp2040
    variants:
    - name: w
```

## zmk_playground_module/boards/nicekeyboards/nice_nano_mcuboot/board.yml
```yaml
board:
  name: nice_nano_mcuboot
  vendor: nicekeyboards
  socs:
    - name: nrf52840
```

## zmk_playground_module/boards/nicekeyboards/nice_nano_mcuboot/nice_nano_mcuboot_defconfig
```kconfig
# SPDX-License-Identifier: MIT

# Enable MPU
CONFIG_ARM_MPU=y

# Use pinctrl
CONFIG_PINCTRL=y

# enable GPIO
CONFIG_GPIO=y

# enable uart driver
CONFIG_SERIAL=y

# enable console
CONFIG_CONSOLE=y
CONFIG_UART_CONSOLE=y
CONFIG_USE_DT_CODE_PARTITION=y
# CONFIG_BUILD_OUTPUT_UF2=y
#
CONFIG_MPU_ALLOW_FLASH_WRITE=y
CONFIG_NVS=y
CONFIG_SETTINGS_NVS=y
CONFIG_FLASH=y
CONFIG_FLASH_PAGE_LAYOUT=y
CONFIG_FLASH_MAP=y

CONFIG_ZMK_BLE=y
CONFIG_ZMK_USB=y
```

## zmk_playground_module/boards/shields/corne_keyboard/Kconfig.defconfig
```kconfig
if SHIELD_CORNE_KEYBOARD_ZMK_LEFT

config ZMK_KEYBOARD_NAME
    default "Corne ZMK"

config ZMK_SPLIT_ROLE_CENTRAL
    default y

endif

if SHIELD_CORNE_KEYBOARD_ZMK_LEFT || SHIELD_CORNE_KEYBOARD_ZMK_RIGHT

config ZMK_SPLIT
    default y

endif
```

## zmk_playground_module/boards/shields/corne_keyboard/Kconfig.shield
```kconfig
# Copyright (c) 2020 Pete Johanson
# SPDX-License-Identifier: MIT

config SHIELD_CORNE_LEFT
    def_bool $(shields_list_contains,corne_keyboard_left)

config SHIELD_CORNE_RIGHT
    def_bool $(shields_list_contains,corne_keyboard_right)

config SHIELD_CORNE_RP2350_RIGHT
    def_bool $(shields_list_contains,corne_keyboard_rp2350_right)

config SHIELD_CORNE_KEYBOARD_ZMK_LEFT
    def_bool $(shields_list_contains,corne_keyboard_zmk_left)

config SHIELD_CORNE_KEYBOARD_ZMK_RIGHT
    def_bool $(shields_list_contains,corne_keyboard_zmk_right)
```

## zmk_playground_module/boards/shields/corne_rpico/Kconfig.defconfig
```kconfig
if SHIELD_CORNE_RPICO_LEFT

config ZMK_KEYBOARD_NAME
    default "Corne rpico"

config ZMK_SPLIT_WIRED
     default y

config ZMK_USB
    default y

config USB_DEVICE_STACK
    default y

config ZMK_SPLIT_ROLE_CENTRAL
    default y

endif

if SHIELD_CORNE_RPICO_LEFT || SHIELD_CORNE_RPICO_RIGHT

config ZMK_SPLIT
    default y

# config ZMK_SPLIT_WIRED
#     default y
endif #SHIELD_CORNE_RPICO_LEFT || SHIELD_CORNE_RPICO_RIGHT
```

## zmk_playground_module/boards/shields/corne_rpico/Kconfig.shield
```kconfig
# Copyright (c) 2020 Pete Johanson
# SPDX-License-Identifier: MIT

config SHIELD_CORNE_RPICO_LEFT
    def_bool $(shields_list_contains,corne_rpico_left)

config SHIELD_CORNE_RPICO_RIGHT
    def_bool $(shields_list_contains,corne_rpico_right)
```

## zmk_playground_module/boards/shields/tester_corne_rpico/Kconfig.shield
```kconfig
# Copyright (c) 2020 Pete Johanson
# SPDX-License-Identifier: MIT

config SHIELD_TESTER_CORNE_RPICO
    def_bool $(shields_list_contains,tester_corne_rpico)
```

## zmk_playground_module/boards/sparkfun/pro_micro_rp2350/Kconfig.defconfig
```kconfig
# Copyright (c) 2025 Ale Alfaro
# SPDX-License-Identifier: Apache-2.0

if BOARD_SPARKFUN_PRO_MICRO_RP2350

config USB_SELF_POWERED
	default n

endif # BOARD_SPARKFUN_PRO_MICRO_RP2350
```

## zmk_playground_module/boards/sparkfun/pro_micro_rp2350/Kconfig.sparkfun_pro_micro_rp2350
```kconfig
# Copyright (c) 2025 Ale Alfaro
# SPDX-License-Identifier: Apache-2.0

config BOARD_SPARKFUN_PRO_MICRO_RP2350
	select SOC_RP2350A_M33 if BOARD_SPARKFUN_PRO_MICRO_RP2350_RP2350A_M33
```

## zmk_playground_module/boards/sparkfun/pro_micro_rp2350/board.yml
```yaml
board:
  name: sparkfun_pro_micro_rp2350
  full_name: Pro Micro RP2350
  vendor: sparkfun
  socs:
  - name: rp2350a
```

## zmk_playground_module/old_corne_rpico/boards/rpi_pico.conf
```kconfig
# Uncomment the following lines to enable the Corne RGB Underglow
# CONFIG_ZMK_RGB_UNDERGLOW=y
# CONFIG_ZMK_KEYBOARD_NAME="Corne rpico"
# CONFIG_ZMK_SPLIT_WIRED=y
CONFIG_GPIO=y
CONFIG_CONSOLE=y
CONFIG_SERIAL=y
CONFIG_UART_CONSOLE=y
CONFIG_UART_INTERRUPT_DRIVEN=y
# CONFIG_ZMK_USB=y
#
# CONFIG_MPU_ALLOW_FLASH_WRITE=y
# CONFIG_NVS=y
# CONFIG_SETTINGS_NVS=y
# CONFIG_FLASH=y
# CONFIG_FLASH_PAGE_LAYOUT=y
# CONFIG_FLASH_MAP=y
```
