/*
 * Copyright (c) 2021 The ZMK Contributors
 *
 * SPDX-License-Identifier: MIT
 */

/dts-v1/;
//TODO:  Support rp2350 as well. Do not hardcode rp2040
#include "rpi_pico-common.dtsi"
#include "common/rpi_pico-led.dtsi"
#include "common/rpi_pico-pinctrl-common.dtsi"
#include "sparkfun_pro_micro_connector.dtsi"


