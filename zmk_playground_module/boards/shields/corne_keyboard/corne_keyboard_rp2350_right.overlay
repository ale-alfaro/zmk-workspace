/*
 * Copyright (c) 2020 Pete Johanson
 *
 * SPDX-License-Identifier: MIT
 */

#include "corne_keyboard_zmk.dtsi"

&default_transform {
    col-offset = <6>;
};

&kscan0 {
    col-gpios
        = <&pro_micro 14 (GPIO_PULL_UP | GPIO_ACTIVE_LOW)>
        , <&pro_micro 15 (GPIO_PULL_UP | GPIO_ACTIVE_LOW)>
        , <&pro_micro 18 (GPIO_PULL_UP | GPIO_ACTIVE_LOW)>
        , <&pro_micro 19 (GPIO_PULL_UP | GPIO_ACTIVE_LOW)>
        , <&pro_micro 20 (GPIO_PULL_UP | GPIO_ACTIVE_LOW)>
        , <&pro_micro 21 (GPIO_PULL_UP | GPIO_ACTIVE_LOW)>
        ;
};
