

#include <zephyr/dt-bindings/input/input-event-codes.h>
#include <zephyr/dt-bindings/input/keymap.h>
#include "corne_keyboard.overlay"
&kbd_corne {

	col-gpios =	<&pro_micro 14 GPIO_ACTIVE_HIGH>, //Leftmost column
			<&pro_micro 15 GPIO_ACTIVE_HIGH>,
			<&pro_micro 18 GPIO_ACTIVE_HIGH>,
			<&pro_micro 19 GPIO_ACTIVE_HIGH>,
			<&pro_micro 20 GPIO_ACTIVE_HIGH>,
			<&pro_micro 21 GPIO_ACTIVE_HIGH>;
	actual-key-mask = <0x0f 0x0f 0x0f 0x07 0x07 0x07>;

		/* Right  side of the keyboard */

	       /*Col#|  0  |  1   |  2  |  3  |  4  |  5   |
	             |GP14 |GP15  |GP18 |GP19 |GP20 |GP21  |
	 Row# ------------------------------------------------
	   0    GP4  |  Y  |  U   |  I  |  O  |  P  | BSPC |
	   1    GP5  |  H  |  J   |  K  |  L  |  ;  |  '   |
	   2    GP6  |  N  |  M   |  ,  |  .  |  /  | ESC  |
	   3    GP7  | ENT | RSE  | ALT | */
	keymap {
		compatible = "input-keymap";
		keymap = <
			MATRIX_KEY(0,0, INPUT_KEY_Y) MATRIX_KEY(0,1, INPUT_KEY_U) MATRIX_KEY(0,2, INPUT_KEY_I) MATRIX_KEY(0,3, INPUT_KEY_O) MATRIX_KEY(0,4, INPUT_KEY_P) MATRIX_KEY(0,5,INPUT_KEY_BACKSPACE)
			MATRIX_KEY(1,0, INPUT_KEY_H) MATRIX_KEY(1,1, INPUT_KEY_J ) MATRIX_KEY(1,2, INPUT_KEY_K) MATRIX_KEY(1,3, INPUT_KEY_L) MATRIX_KEY(1,4, INPUT_KEY_SEMICOLON) MATRIX_KEY(1,5, INPUT_KEY_GRAVE)
			MATRIX_KEY(2,0, INPUT_KEY_N) MATRIX_KEY(2,1, INPUT_KEY_M ) MATRIX_KEY(2,2, INPUT_KEY_COMMA) MATRIX_KEY(2,3, INPUT_KEY_DOT) MATRIX_KEY(2,4, INPUT_KEY_SLASH) MATRIX_KEY(2,5, INPUT_KEY_ESC)
			MATRIX_KEY(3,0, INPUT_KEY_ENTER) MATRIX_KEY(3,1, INPUT_KEY_LEFTBRACE) MATRIX_KEY(3,2, INPUT_KEY_RIGHTALT)
		>;
		row-size = <4>;
		col-size = <6>;
	};
};

