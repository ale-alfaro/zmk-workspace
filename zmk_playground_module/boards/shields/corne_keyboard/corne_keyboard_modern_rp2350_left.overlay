#include <zephyr/dt-bindings/input/input-event-codes.h>
#include <zephyr/dt-bindings/input/keymap.h>
#include "corne_keyboard_rp2350.overlay"
&kbd_corne {

    row-gpios
        = <&pro_micro 21 (GPIO_PULL_UP | GPIO_ACTIVE_LOW)>
        , <&pro_micro 20 (GPIO_PULL_UP | GPIO_ACTIVE_LOW)>
        , <&pro_micro 19 (GPIO_PULL_UP | GPIO_ACTIVE_LOW)>
        , <&pro_micro 18 (GPIO_PULL_UP | GPIO_ACTIVE_LOW)>
        , <&pro_micro 15 (GPIO_PULL_UP | GPIO_ACTIVE_LOW)>
        , <&pro_micro 14 (GPIO_PULL_UP | GPIO_ACTIVE_LOW)>
        ;
	actual-key-mask = <0x3F 0x3F 0x3F 0x38>;

    /* Left side of the keyboard - Flipped Axis for RP2350

      Col#  |  0  |  1   |  2  |  3  |
            |GP4  |GP5   |GP6  |GP7  |
  Row#      |-----|------|-----|-----|
   0    GP21| TAB | CTRL | SHFT|     |
   1    GP20|  Q  |  A   |  Z  |     |
   2    GP19|  W  |  S   |  X  |     |
   3    GP18|  E  |  D   |  C  | GUI |
   4    GP15|  R  |  F   |  V  | LWR |
   5    GP14|  T  |  G   |  B  | SPC |
     */
	keymap {
		compatible = "input-keymap";
		keymap = <
			MATRIX_KEY(0,0, INPUT_KEY_TAB)       MATRIX_KEY(0,1, INPUT_KEY_LEFTCTRL)  MATRIX_KEY(0,2, INPUT_KEY_LEFTSHIFT)
			MATRIX_KEY(1,0, INPUT_KEY_Q)         MATRIX_KEY(1,1, INPUT_KEY_A)         MATRIX_KEY(1,2, INPUT_KEY_Z)
			MATRIX_KEY(2,0, INPUT_KEY_W)         MATRIX_KEY(2,1, INPUT_KEY_S)         MATRIX_KEY(2,2, INPUT_KEY_X)
			MATRIX_KEY(3,0, INPUT_KEY_E)         MATRIX_KEY(3,1, INPUT_KEY_D)         MATRIX_KEY(3,2, INPUT_KEY_C)         MATRIX_KEY(3,3, INPUT_KEY_LEFTMETA)
			MATRIX_KEY(4,0, INPUT_KEY_R)         MATRIX_KEY(4,1, INPUT_KEY_F)         MATRIX_KEY(4,2, INPUT_KEY_V)         MATRIX_KEY(4,3, INPUT_KEY_LEFTALT)
			MATRIX_KEY(5,0, INPUT_KEY_T)         MATRIX_KEY(5,1, INPUT_KEY_G)         MATRIX_KEY(5,2, INPUT_KEY_B)         MATRIX_KEY(5,3, INPUT_KEY_SPACE)
		>;
		row-size = <6>;
		col-size = <4>;
	};
};
