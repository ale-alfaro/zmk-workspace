#include <zephyr/dt-bindings/input/input-event-codes.h>
#include <zephyr/dt-bindings/input/keymap.h>
#include "corne_keyboard.overlay"
&kbd_corne {

	col-gpios =	< &pro_micro 21 GPIO_ACTIVE_HIGH>, //Leftmost column
			< &pro_micro 20 GPIO_ACTIVE_HIGH>,
			< &pro_micro 19 GPIO_ACTIVE_HIGH>,
			< &pro_micro 18 GPIO_ACTIVE_HIGH>,
			< &pro_micro 15 GPIO_ACTIVE_HIGH>,
			< &pro_micro 14 GPIO_ACTIVE_HIGH>;
	actual-key-mask = <0x07 0x07 0x07 0x0f 0x0f 0x0f>;

 /*	Left side of the keyboard

      Col#  |  0  |  1   |  2  |  3  |  4  |  5   |
            |GP21 |GP20  |GP19 |GP18 |GP15 |GP14  |
  Row#|-----|------|-----|-----|-----|------|
   0    GP4 | TAB |  Q   |  W  |  E  |  R  |  T   |
   1    GP5 | CTRL|  A   |  S  |  D  |  F  |  G   |
   2   GP6  | SHFT|  Z   |  X  |  C  |  V  |  B   |
   3    GP7 |     |      |     | GUI | LWR | SPC  |
     */
	keymap {
		compatible = "input-keymap";
		keymap = <
			MATRIX_KEY(0,0, INPUT_KEY_TAB)       MATRIX_KEY(0,1, INPUT_KEY_Q) MATRIX_KEY(0,2, INPUT_KEY_W) MATRIX_KEY(0,3, INPUT_KEY_E) MATRIX_KEY(0,4, INPUT_KEY_R) MATRIX_KEY(0,5, INPUT_KEY_T)
			MATRIX_KEY(1,0, INPUT_KEY_LEFTCTRL)  MATRIX_KEY(1,1, INPUT_KEY_A) MATRIX_KEY(1,2, INPUT_KEY_S) MATRIX_KEY(1,3, INPUT_KEY_D) MATRIX_KEY(1,4, INPUT_KEY_F) MATRIX_KEY(1,5, INPUT_KEY_G)
			MATRIX_KEY(2,0, INPUT_KEY_LEFTSHIFT) MATRIX_KEY(2,1, INPUT_KEY_Z) MATRIX_KEY(2,2, INPUT_KEY_X) MATRIX_KEY(2,3, INPUT_KEY_C) MATRIX_KEY(2,4, INPUT_KEY_V) MATRIX_KEY(2,5, INPUT_KEY_B)
			                                                                  MATRIX_KEY(3,3, INPUT_KEY_LEFTMETA) MATRIX_KEY(3,4, INPUT_KEY_LEFTALT) MATRIX_KEY(3,5, INPUT_KEY_SPACE)
		>;
		row-size = <4>;
		col-size = <6>;
	};
};
