/*
 * Copyright (c) 2020 Pete Johanson
 *
 * SPDX-License-Identifier: MIT
 */

#include "dts/corne_rpico_common.dtsi"
/{
    hid_dev_0: hid_dev_0 {
        compatible = "zephyr,hid-device";
        label = "HID0";
        protocol-code = "keyboard";
        in-report-size = <64>;
        in-polling-period-us = <1000>;
    };
};

zephyr_udc0: &usbd {
	status = "okay";
};

&kscan0 {
    col-gpios
        = <&gpio0 2 GPIO_ACTIVE_HIGH>
        , <&gpio0 3 GPIO_ACTIVE_HIGH>

        , <&gpio0 4 GPIO_ACTIVE_HIGH>
        , <&gpio0 5 GPIO_ACTIVE_HIGH>
        , <&gpio0 6 GPIO_ACTIVE_HIGH>
        , <&gpio0 7 GPIO_ACTIVE_HIGH>
        ;
};
